/dts-v1/;
#include "../_biba40_common.dtsi"

&{/} {
    compatible = "zmk,keyboard";
}

/* RIGHT PCB — your provided col order (note reversed order vs left) */
&kscan0 {
    col-gpios = <&pro_micro 21 GPIO_ACTIVE_HIGH>,
                <&pro_micro 20 GPIO_ACTIVE_HIGH>,
                <&pro_micro 19 GPIO_ACTIVE_HIGH>,
                <&pro_micro 18 GPIO_ACTIVE_HIGH>,
                <&pro_micro 15 GPIO_ACTIVE_HIGH>,
                <&pro_micro 14 GPIO_ACTIVE_HIGH>;
}

/* Rotate 90° CW from original 4×6 to a logical 6×4 */
&{/} {
    kscan_transform_right: kscan_transform_right {
        compatible = "zmk,kscan-transform";
        label = "BIBA_MACRO_KSCAN_TRANSFORM_RIGHT";
        input = <&kscan0>;
        rows = <6>;
        columns = <4>;

        /* new(r,c) -> old(3 - c, r) for old 4×6 */
        transform = <ZMK_MATRIX_TRANSFORM(
            KSCAN_MATRIX_KEY(3,0), KSCAN_MATRIX_KEY(2,0), KSCAN_MATRIX_KEY(1,0), KSCAN_MATRIX_KEY(0,0),
            KSCAN_MATRIX_KEY(3,1), KSCAN_MATRIX_KEY(2,1), KSCAN_MATRIX_KEY(1,1), KSCAN_MATRIX_KEY(0,1),
            KSCAN_MATRIX_KEY(3,2), KSCAN_MATRIX_KEY(2,2), KSCAN_MATRIX_KEY(1,2), KSCAN_MATRIX_KEY(0,2),
            KSCAN_MATRIX_KEY(3,3), KSCAN_MATRIX_KEY(2,3), KSCAN_MATRIX_KEY(1,3), KSCAN_MATRIX_KEY(0,3),
            KSCAN_MATRIX_KEY(3,4), KSCAN_MATRIX_KEY(2,4), KSCAN_MATRIX_KEY(1,4), KSCAN_MATRIX_KEY(0,4),
            KSCAN_MATRIX_KEY(3,5), KSCAN_MATRIX_KEY(2,5), KSCAN_MATRIX_KEY(1,5), KSCAN_MATRIX_KEY(0,5)
        )>;
    };
};

&chosen { zmk,kscan = &kscan_transform_right; };
